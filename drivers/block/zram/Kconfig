## drivers/block/zram/Kconfig
```kconfig
config ZRAM
	tristate "Compressed RAM block device support"
	depends on BLOCK && SYSFS && ZRAM_Z3FOLD && CRYPTO
	select LZO_COMPRESS
	select LZO_DECOMPRESS
	default n
	help
	  Creates virtual block devices called /dev/zramX (X = 0, 1, ...).
	  Pages written to these disks are compressed and stored in memory
	  itself. These disks allow very fast I/O and compression provides
	  good amounts of memory savings.

	  It has several use cases, for example: /tmp storage, use as swap
	  disks and maybe many more.

	  See zram.txt for more information.

config ZRAM_LZ4_COMPRESS
	bool "Enable LZ4 algorithm support"
	depends on ZRAM
	select LZ4_COMPRESS
	select LZ4_DECOMPRESS
	default n
	help
	  This option enables LZ4 compression algorithm support. Compression
	  algorithm can be changed using `comp_algorithm' device attribute.


config ZRAM_DEFAULT_COMP_ALGORITHM
	string "Default ZRAM algorithm"
	default "lzo"

if ZRAM

choice
	prompt "Default zRAM compressed memory allocator"
	default ZRAM_DEFAULT_ZSMALLOC
	help
	  Select the compressed memory allocator that will be used by default
	  for all devices.

	config ZRAM_DEFAULT_ZBUD
		bool "zbud"
		select ZBUD

	config ZRAM_DEFAULT_Z3FOLD
		bool "z3fold"
		select Z3FOLD

	config ZRAM_DEFAULT_ZSMALLOC
		bool "zsmalloc"
		select ZSMALLOC

endchoice

config ZRAM_DEFAULT_POOL
	string
	default "zbud" if ZRAM_DEFAULT_ZBUD
	default "z3fold" if ZRAM_DEFAULT_Z3FOLD
	default "zsmalloc" if ZRAM_DEFAULT_ZSMALLOC

endif
```
